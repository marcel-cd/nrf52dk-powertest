## CMakeLists.txt
```
# Copyright (c) 2024 Nordic Semiconductor ASA
# SPDX-License-Identifier: Apache-2.0

cmake_minimum_required(VERSION 3.20.0)
find_package(Zephyr REQUIRED HINTS $ENV{ZEPHYR_BASE})

project(nrf52dkpower)

target_sources(app PRIVATE src/main.c)
```

## prj.conf
```kconfig
# FLPR configuration
CONFIG_UART_CONSOLE=n
CONFIG_SERIAL=n
CONFIG_LOG=n
CONFIG_CONSOLE=n

CONFIG_PM_DEVICE=y
CONFIG_PM_DEVICE_RUNTIME=y
```

## boards/nrf52840dk_nrf52840.overlay
```dts
&uart0 {
   status = "disabled";
};
&uart1 {
   status = "disabled";
};
&adc {
   status = "disabled";
};
```

## src/main.c
```c
#include <zephyr/sys/printk.h>
#include <zephyr/kernel.h>

int main(void) {
  printk("HELLO from cpuapp\n");
  while (true) {
    k_msleep(100000);
  }
  return 0;
}
```
